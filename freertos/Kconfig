## freertos/Kconfig
```kconfig
# Copyright 2025 NXP
#
# SPDX-License-Identifier: BSD-3-Clause

config MCUX_COMPONENT_component.rtos_abstraction_layer_freertos
    bool "FreeRTOS RTOS Abstraction Layer"

    if MCUX_COMPONENT_component.rtos_abstraction_layer_freertos
    endif
```
